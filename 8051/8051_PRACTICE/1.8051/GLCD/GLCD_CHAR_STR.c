#include <reg52.h>

/**LCD PIN DEFINITION**/
#define lcd P0

// IN-BUILT FOR T.B

sbit RS=P3^4; 
sbit RW=P3^5;
sbit EN=P3^6;

sbit RST=P3^7;
sbit CS2=P2^3;
sbit CS1=P2^2;

void glcd_init();
void write_cmd(unsigned char cmd);
void glcd_clr(unsigned char val);
void delay(unsigned int t);
void write_dat(unsigned char dat);

void glcd_str(unsigned char page, unsigned char hposi, unsigned char *ch);
void glcd_char(unsigned char page, unsigned char hposi, unsigned char ch);


code unsigned char arr[95][6] =
{  
   {0x00,0x00,0x00,0x00,0x00,0},   	//  space 
   {0x00,0x00,0x4F,0x00,0x00,0},      	//  '!'
   {0x00,0x07,0x00,0x07,0x00,0},      	//  '"'
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   {0x00,0x08,0x04,0x08,0x04,0}         //  '~'
};
void main()
{
	glcd_init();
	glcd_clr(0);
	write_cmd(0xc0);
	glcd_char(0xb8,0x40,'1');
	delay(150);
	write_cmd(0xc5);
	glcd_str(0xbd,0x47,"vector");
	delay(150);

	while(1);
}

void glcd_char(unsigned char page, unsigned char hposi, unsigned char ch)
{
	unsigned char i,j;
	write_cmd(hposi);
	write_cmd(page);
	CS1=1;
	CS2=0;
	j=ch-32;
	for(i=0;i<6;i++)
	{
		write_dat(arr[j][i]);
	}
}

void glcd_str(unsigned char page, unsigned char hposi, unsigned char *ch)
{
	unsigned char i,j,k;
	while(*ch!='\0')
	{
		write_cmd(hposi);
		write_cmd(page);
		CS1=1;
		CS2=0;
		for(k=0;k<10;k++)
		{
			if(*ch=='\0')
				break;
			j=*ch-32;
			ch++;
			for(i=0;i<6;i++)
			{
				write_dat(arr[j][i]);
			}
		}
	}
}

void glcd_init(void)
{   
    /*******RESET***********/
	RST = 0;
    delay(10);
    RST = 1;
    delay(1);
	/**********************/
    EN = 0;
    CS1 = 0;
    CS2 = 0;
    RW = 0;
    RS = 0;
    write_cmd(0x3e);	      // 0x3E turn it Off.
    write_cmd(0x3f);	     // 0x3F Display ON.
    write_cmd(0x40);         // display data in horizontal way(0-63) 
    write_cmd(0xb8);        // display data in vertical way(0-7)
    write_cmd(0xc0); 	   // indicates the display data RAM displayed on the top of the screen              
}
void write_cmd(unsigned char cmd)
{
	RS = 0; 
    CS1 = 1;
    CS2 = 1;                             
    lcd =  cmd;
    EN = 1;                
    EN = 0;               
}
void write_dat(unsigned char dat)
{
	RS = 1;	
    lcd = dat;
    EN = 1;
	EN = 0;
}
void glcd_clr(unsigned char val)
{
     int i,y;
     CS1 = 1;
     CS2 = 1;	
     for(i=0xb8;i<0xc0;i++)
     {
            write_cmd(i);                        // Select Pages.  
	        write_cmd(0x40);                      
            for (y=0;y<64;y++)
   	   	 		write_dat(val);                  // Clear data in the LCD.
	 }
}
void delay(unsigned int t)
{
	unsigned int x,y;
	for(x=0;x<1275;x++)
		for(y=0;y<t;y++);	
}